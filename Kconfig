## Kconfig
```kconfig
menu "Blackbox Logger Configuration"

    menu "Buffer and Memory Settings"
        config BLACKBOX_DEFAULT_BUFFER_SIZE
            int "Default ring buffer size (KB)"
            default 32
            range 16 128
            help
                Default size of the ring buffer in kilobytes.
                Larger buffers reduce the chance of message drops during
                high-frequency logging but consume more RAM.
                Minimum: 16 KB, Maximum: 128 KB

        config BLACKBOX_MIN_BUFFER_SIZE
            int "Minimum ring buffer size (KB)"
            default 16
            range 8 32
            help
                Minimum allowed ring buffer size in kilobytes.
                Users cannot configure a buffer smaller than this value.

        config BLACKBOX_MAX_MESSAGE_SIZE
            int "Maximum message payload size (bytes)"
            default 256
            range 64 1024
            help
                Maximum size of a single log message payload in bytes.
                Larger values allow longer messages but increase memory usage
                per log entry.
    endmenu

    menu "File Settings"
        config BLACKBOX_DEFAULT_FILE_SIZE_LIMIT
            int "Default file size limit for rotation (KB)"
            default 512
            range 64 4096
            help
                Default maximum size of a single log file in kilobytes.
                When a log file reaches this size, a new file is created.
                Larger files reduce overhead but may be harder to manage.

        config BLACKBOX_MAX_PATH_LENGTH
            int "Maximum path length (bytes)"
            default 128
            range 64 256
            help
                Maximum length of file paths used by the logger.
                Increase if you use deeply nested directories.

        config BLACKBOX_DEFAULT_FLUSH_INTERVAL
            int "Default flush interval (ms)"
            default 200
            range 50 5000
            help
                Default interval in milliseconds between automatic buffer
                flushes to the filesystem. Lower values reduce data loss
                risk but increase I/O overhead.
    endmenu

    menu "Task Settings"
        config BLACKBOX_WRITER_TASK_STACK_SIZE
            int "Writer task stack size (bytes)"
            default 4096
            range 2048 8192
            help
                Stack size for the background writer task that handles
                file I/O operations. Increase if you experience stack
                overflow issues.

        config BLACKBOX_WRITER_TASK_PRIORITY
            int "Writer task priority"
            default 2
            range 1 10
            help
                FreeRTOS priority for the background writer task.
                Lower values mean lower priority. Keep this low to avoid
                interfering with time-critical tasks.
    endmenu

    menu "Tag and Logging Settings"
        config BLACKBOX_MAX_TAG_LENGTH
            int "Maximum tag length (bytes)"
            default 32
            range 8 64
            help
                Maximum length of component tag strings.
                Tags longer than this will be truncated.
    endmenu

    menu "Panic Handler Settings"
        config BLACKBOX_PANIC_MEMORY_DUMP_SIZE
            int "Panic memory dump size (bytes)"
            default 256
            range 64 1024
            help
                Size of the memory dump around the stack pointer captured
                during a panic. Larger values provide more context but
                take longer to write during crash.
                This is only used if panic handler is enabled at runtime
                via the config struct.
    endmenu

    menu "Log Format Settings"
        choice BLACKBOX_DEFAULT_LOG_FORMAT
            prompt "Default log file format"
            default BLACKBOX_FORMAT_NATIVE
            help
                Select the default log file format.
                BBOX (Native) - Custom binary format with optional encryption
                PX4 ULog - Compatible with PX4/QGroundControl analysis tools
                ArduPilot DataFlash - Compatible with Mission Planner

            config BLACKBOX_FORMAT_NATIVE
                bool "BBOX (Native)"
                help
                    Native blackbox binary format with optional AES-256
                    encryption support. Use for custom applications.

            config BLACKBOX_FORMAT_PX4
                bool "PX4 ULog (.ulg)"
                help
                    PX4 ULog format compatible with PX4 flight stack and
                    analysis tools like FlightPlot, PlotJuggler, and
                    QGroundControl log viewer.

            config BLACKBOX_FORMAT_ARDUPILOT_DF
                bool "ArduPilot DataFlash (.bin)"
                help
                    ArduPilot DataFlash binary format compatible with
                    Mission Planner, MAVExplorer, and other ArduPilot
                    log analysis tools.
        endchoice

        config BLACKBOX_STRUCT_LOGGING_ENABLED
            bool "Enable structured message logging"
            default y
            help
                Enable structured data logging for IMU, GPS, attitude,
                PID, motor, and other flight controller data types.
                Disable to reduce code size if only text logging is needed.
    endmenu

endmenu
```

## examples/encryption_example/sdkconfig.defaults
```kconfig
# Log output
CONFIG_LOG_DEFAULT_LEVEL_INFO=y
CONFIG_LOG_MAXIMUM_LEVEL_DEBUG=y

# FAT filesystem support (for SD card)
CONFIG_FATFS_LONG_FILENAMES=y
CONFIG_FATFS_LFN_HEAP=y
CONFIG_FATFS_MAX_LFN=255

# mbedTLS (required for AES encryption)
CONFIG_MBEDTLS_AES_C=y
CONFIG_MBEDTLS_CIPHER_MODE_CTR=y
```

## examples/flight_data_example/sdkconfig.defaults
```kconfig
# Partition table
CONFIG_PARTITION_TABLE_CUSTOM=y
CONFIG_PARTITION_TABLE_CUSTOM_FILENAME="partitions.csv"

# SPIFFS
CONFIG_SPIFFS_MAX_PARTITIONS=3

# Log output
CONFIG_LOG_DEFAULT_LEVEL_INFO=y
CONFIG_LOG_MAXIMUM_LEVEL_DEBUG=y

# Blackbox logger - use PX4 ULog format
CONFIG_BLACKBOX_FORMAT_PX4=y
CONFIG_BLACKBOX_STRUCT_LOGGING_ENABLED=y
```

## examples/sdcard_example/sdkconfig.defaults
```kconfig
# Log output
CONFIG_LOG_DEFAULT_LEVEL_INFO=y
CONFIG_LOG_MAXIMUM_LEVEL_DEBUG=y

# FAT filesystem support (for SD card)
CONFIG_FATFS_LONG_FILENAMES=y
CONFIG_FATFS_LFN_HEAP=y
CONFIG_FATFS_MAX_LFN=255
```

## examples/spiffs_example/sdkconfig.defaults
```kconfig
# Partition table
CONFIG_PARTITION_TABLE_CUSTOM=y
CONFIG_PARTITION_TABLE_CUSTOM_FILENAME="partitions.csv"

# SPIFFS
CONFIG_SPIFFS_MAX_PARTITIONS=3

# Log output
CONFIG_LOG_DEFAULT_LEVEL_INFO=y
CONFIG_LOG_MAXIMUM_LEVEL_DEBUG=y
```
